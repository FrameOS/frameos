/* The 5x7 bitmap font of the pure-C status screens: one glyph is seven rows,
 * bit 4 of a row is its leftmost column. Shared by the ESP32 status screen
 * (fos_status_screen.c) and the Pico firmware's scanline status screen
 * (embedded/pico/src/pk_status_screen.c), so both boards spell the setup
 * instructions with the same letters. No dependencies. */
#pragma once
#include <stddef.h>
#include <stdint.h>

static const uint8_t FOS_FONT5X7_DIGITS[10][7] = {
    {0x0E, 0x11, 0x13, 0x15, 0x19, 0x11, 0x0E},
    {0x04, 0x0C, 0x04, 0x04, 0x04, 0x04, 0x0E},
    {0x0E, 0x11, 0x01, 0x02, 0x04, 0x08, 0x1F},
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    {0x0E, 0x11, 0x11, 0x0F, 0x01, 0x01, 0x0E},
};

static const uint8_t FOS_FONT5X7_LETTERS[26][7] = {
    {0x0E, 0x11, 0x11, 0x1F, 0x11, 0x11, 0x11},
    {0x1E, 0x11, 0x11, 0x1E, 0x11, 0x11, 0x1E},
    {0x0F, 0x10, 0x10, 0x10, 0x10, 0x10, 0x0F},
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    {0x1F, 0x01, 0x02, 0x04, 0x08, 0x10, 0x1F},
};

static const uint8_t FOS_FONT5X7_LOWER_LETTERS[26][7] = {
    {0x00, 0x00, 0x0E, 0x01, 0x0F, 0x11, 0x0F},
    {0x10, 0x10, 0x1E, 0x11, 0x11, 0x11, 0x1E},
    {0x00, 0x00, 0x0F, 0x10, 0x10, 0x10, 0x0F},
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    {0x00, 0x00, 0x1F, 0x02, 0x04, 0x08, 0x1F},
};

static const uint8_t FOS_FONT5X7_GLYPH_DASH[7] = {0x00, 0x00, 0x00, 0x1F, 0x00, 0x00, 0x00};
static const uint8_t FOS_FONT5X7_GLYPH_DOT[7] = {0x00, 0x00, 0x00, 0x00, 0x00, 0x0C, 0x0C};
static const uint8_t FOS_FONT5X7_GLYPH_COLON[7] = {0x00, 0x0C, 0x0C, 0x00, 0x0C, 0x0C, 0x00};
static const uint8_t FOS_FONT5X7_GLYPH_SLASH[7] = {0x01, 0x02, 0x02, 0x04, 0x08, 0x08, 0x10};
static const uint8_t FOS_FONT5X7_GLYPH_LPAREN[7] = {0x02, 0x04, 0x08, 0x08, 0x08, 0x04, 0x02};
static const uint8_t FOS_FONT5X7_GLYPH_RPAREN[7] = {0x08, 0x04, 0x02, 0x02, 0x02, 0x04, 0x08};
static const uint8_t FOS_FONT5X7_GLYPH_COMMA[7] = {0x00, 0x00, 0x00, 0x00, 0x0C, 0x04, 0x08};
static const uint8_t FOS_FONT5X7_GLYPH_QUOTE[7] = {0x0A, 0x0A, 0x00, 0x00, 0x00, 0x00, 0x00};

static inline const uint8_t *fos_font5x7_glyph(char raw)
{
    unsigned char c = (unsigned char)raw;
    if (c >= 'A' && c <= 'Z') return FOS_FONT5X7_LETTERS[c - 'A'];
    if (c >= 'a' && c <= 'z') return FOS_FONT5X7_LOWER_LETTERS[c - 'a'];
    if (c >= '0' && c <= '9') return FOS_FONT5X7_DIGITS[c - '0'];
    if (c == '-') return FOS_FONT5X7_GLYPH_DASH;
    if (c == '.') return FOS_FONT5X7_GLYPH_DOT;
    if (c == ':') return FOS_FONT5X7_GLYPH_COLON;
    if (c == '/') return FOS_FONT5X7_GLYPH_SLASH;
    if (c == '(') return FOS_FONT5X7_GLYPH_LPAREN;
    if (c == ')') return FOS_FONT5X7_GLYPH_RPAREN;
    if (c == ',') return FOS_FONT5X7_GLYPH_COMMA;
    if (c == '"') return FOS_FONT5X7_GLYPH_QUOTE;
    return NULL;
}
