/*
 * Touch for the Pimoroni HyperPixel 4.0 Square, and nothing else.
 *
 * The FrameOS hyperPixel4 driver owns the display side (firmware DPI, the
 * panel init bus, the backlight), so unlike vc4-kms-dpi-hyperpixel4sq or
 * Pimoroni's hyperpixel4 overlay this one claims no DPI pin and no GPIO 19.
 * The touch node is the kernel overlay's: an FT5x06 at 0x48 on a bit-banged
 * I2C bus (SDA 10, SCL 11), interrupt on GPIO 27, reporting 720x720.
 *
 * Build: dtc -@ -I dts -O dtb -o frameos-hyperpixel4sq-touch.dtbo frameos-hyperpixel4sq-touch.dts
 */

/dts-v1/;
/plugin/;

/ {
	compatible = "brcm,bcm2835";

	fragment@0 {
		target-path = "/";
		__overlay__ {
			frameos_hyperpixel4_i2c: i2c@0 {
				compatible = "i2c-gpio";
				gpios = <&gpio 10 6 /* sda, open drain */
					 &gpio 11 6>; /* scl, open drain */
				i2c-gpio,delay-us = <4>; /* ~100 kHz */
				#address-cells = <1>;
				#size-cells = <0>;

				touch@48 {
					compatible = "edt,edt-ft5406";
					reg = <0x48>;
					interrupt-parent = <&gpio>;
					interrupts = <27 2>;
					touchscreen-size-x = <720>;
					touchscreen-size-y = <720>;
				};
			};
		};
	};
};
