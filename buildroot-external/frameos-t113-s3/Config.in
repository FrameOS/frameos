## buildroot-external/frameos-t113-s3/Config.in
```kconfig
source "$BR2_EXTERNAL_FRAMEOS_T113_S3_PATH/package/frameos-quickjs/Config.in"
source "$BR2_EXTERNAL_FRAMEOS_T113_S3_PATH/package/frameos-lgpio/Config.in"
```

## buildroot-external/frameos-t113-s3/configs/frameos_t113_s3_mangopi_mq_dual_defconfig
```kconfig
BR2_arm=y
BR2_cortex_a7=y
BR2_ARM_FPU_VFPV4=y
BR2_TOOLCHAIN_BUILDROOT_GLIBC=y
BR2_TARGET_GENERIC_HOSTNAME="frameos-t113-s3"
BR2_TARGET_GENERIC_ISSUE="Welcome to FrameOS T113-S3"
BR2_ROOTFS_DEVICE_CREATION_DYNAMIC_EUDEV=y
BR2_TARGET_GENERIC_GETTY_PORT="ttyS3"
BR2_SYSTEM_DHCP="eth0"
BR2_ROOTFS_OVERLAY="$(BR2_EXTERNAL_FRAMEOS_T113_S3_PATH)/board/mangopi/mq-dual/rootfs_overlay"
BR2_ROOTFS_POST_BUILD_SCRIPT="$(BR2_EXTERNAL_FRAMEOS_T113_S3_PATH)/board/mangopi/mq-dual/post-build.sh"
BR2_ROOTFS_POST_IMAGE_SCRIPT="support/scripts/genimage.sh"
BR2_ROOTFS_POST_SCRIPT_ARGS="-c $(BR2_EXTERNAL_FRAMEOS_T113_S3_PATH)/board/mangopi/mq-dual/genimage.cfg"
BR2_LINUX_KERNEL=y
BR2_LINUX_KERNEL_CUSTOM_VERSION=y
BR2_LINUX_KERNEL_CUSTOM_VERSION_VALUE="6.6.5"
BR2_LINUX_KERNEL_DEFCONFIG="sunxi"
BR2_PACKAGE_HOST_LINUX_HEADERS_CUSTOM_6_6=y
BR2_LINUX_KERNEL_DTS_SUPPORT=y
BR2_LINUX_KERNEL_INTREE_DTS_NAME="allwinner/sun8i-t113s-mangopi-mq-r-t113"
BR2_LINUX_KERNEL_INSTALL_TARGET=y
BR2_LINUX_KERNEL_NEEDS_HOST_OPENSSL=y
BR2_PACKAGE_CA_CERTIFICATES=y
BR2_PACKAGE_DROPBEAR=y
BR2_PACKAGE_FRAMEOS_LGPIO=y
BR2_PACKAGE_FRAMEOS_QUICKJS=y
BR2_PACKAGE_OPENSSL=y
BR2_TARGET_ROOTFS_EXT2=y
BR2_TARGET_ROOTFS_EXT2_4=y
# BR2_TARGET_ROOTFS_TAR is not set
BR2_TARGET_UBOOT=y
BR2_TARGET_UBOOT_BUILD_SYSTEM_KCONFIG=y
BR2_TARGET_UBOOT_CUSTOM_VERSION=y
BR2_TARGET_UBOOT_CUSTOM_VERSION_VALUE="2024.01"
BR2_TARGET_UBOOT_BOARD_DEFCONFIG="mangopi_mq_r"
BR2_TARGET_UBOOT_NEEDS_DTC=y
BR2_TARGET_UBOOT_NEEDS_PYLIBFDT=y
BR2_TARGET_UBOOT_NEEDS_OPENSSL=y
BR2_TARGET_UBOOT_SPL=y
BR2_TARGET_UBOOT_SPL_NAME="u-boot-sunxi-with-spl.bin"
BR2_PACKAGE_HOST_GENIMAGE=y
```

## buildroot-external/frameos-t113-s3/package/frameos-lgpio/Config.in
```kconfig
config BR2_PACKAGE_FRAMEOS_LGPIO
	bool "frameos lgpio"
	help
	  Build and stage lgpio for FrameOS GPIO, SPI, I2C, and serial access.
```

## buildroot-external/frameos-t113-s3/package/frameos-quickjs/Config.in
```kconfig
config BR2_PACKAGE_FRAMEOS_QUICKJS
	bool "frameos quickjs"
	help
	  Build and stage QuickJS headers and static library for the FrameOS
	  interpreter.
```

## embedded/esp32/sdkconfig.defaults.16mb-ota
```kconfig
# Optional production profile. Use with:
#   SDKCONFIG_DEFAULTS="sdkconfig.defaults;sdkconfig.defaults.16mb-ota" idf.py reconfigure build
CONFIG_ESPTOOLPY_FLASHSIZE_16MB=y
# CONFIG_ESPTOOLPY_FLASHSIZE_8MB is not set
CONFIG_PARTITION_TABLE_CUSTOM_FILENAME="partitions_ota_16mb.csv"
CONFIG_BOOTLOADER_APP_ROLLBACK_ENABLE=y
```

## embedded/esp32/sdkconfig.defaults.32mb-ota
```kconfig
# 32MB production profile with larger state storage.
CONFIG_ESPTOOLPY_FLASHSIZE_32MB=y
# CONFIG_ESPTOOLPY_FLASHSIZE_8MB is not set
CONFIG_PARTITION_TABLE_CUSTOM_FILENAME="partitions_ota_32mb.csv"
CONFIG_BOOTLOADER_APP_ROLLBACK_ENABLE=y
# Keep the 24MB SPIFFS state partition below SPIFFS' 16-bit page index limit.
CONFIG_SPIFFS_PAGE_SIZE=512
```

## embedded/esp32/sdkconfig.defaults.4mb-no-ota
```kconfig
# 4MB modules do not have enough room for two FrameOS app slots plus state.
# Build one factory app and disable OTA rollback checks.
CONFIG_ESPTOOLPY_FLASHSIZE_4MB=y
# CONFIG_ESPTOOLPY_FLASHSIZE_8MB is not set
CONFIG_PARTITION_TABLE_CUSTOM_FILENAME="partitions_4mb.csv"
# CONFIG_BOOTLOADER_APP_ROLLBACK_ENABLE is not set
```

## frameos/buildroot/external/Config.in
```kconfig
menu "FrameOS customisations"

comment "Additional FrameOS packages can be selected here in the future"

endmenu
```

## frameos/buildroot/external/configs/frameos_luckfox_rv1106_defconfig
```kconfig
# FrameOS Buildroot configuration for the Luckfox Pico Pro/Max (Rockchip RV1106)
BR2_riscv=y
BR2_RISCV_ABI_ILP32D=y
BR2_RISCV_ISA_RV32IMAFDC=y
BR2_TOOLCHAIN_BUILDROOT_GLIBC=y
BR2_TOOLCHAIN_BUILDROOT_CXX=y
BR2_TOOLCHAIN_BUILDROOT_LOCALE=y
BR2_PACKAGE_HOST_LINUX_HEADERS_CUSTOM_6_6=y
BR2_TARGET_GENERIC_HOSTNAME="frameos"
BR2_TARGET_GENERIC_ISSUE="FrameOS (Luckfox RV1106)"
BR2_TARGET_GENERIC_GETTY_PORT="ttyS0"
BR2_ROOTFS_OVERLAY="$(BR2_EXTERNAL_FRAMEOS_PATH)/board/luckfox/pico_pro_max/rootfs_overlay"
BR2_ROOTFS_DEVICE_CREATION_DYNAMIC_EUDEV=y
BR2_PACKAGE_EUDEV=y
BR2_PACKAGE_BUSYBOX=y
BR2_TARGET_ROOTFS_EXT2=y
BR2_TARGET_ROOTFS_EXT2_4=y
BR2_TARGET_ROOTFS_TAR=y
```
